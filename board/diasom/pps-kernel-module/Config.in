## board/diasom/pps-kernel-module/package/pps-gen-drv/Config.in
```kconfig
config BR2_PACKAGE_PPS_GEN_DRV
    bool "pps-gen-drv"
    depends on BR2_LINUX_KERNEL
    help
      Custom PPS generator kernel module (pps-gen-gpio).
```
