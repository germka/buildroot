## configs/diasom_rk35xx_uspd_defconfig
```kconfig
BR2_aarch64=y
BR2_cortex_a55=y
BR2_KERNEL_HEADERS_6_12=y
BR2_PACKAGE_GLIBC_KERNEL_COMPAT=y
BR2_PACKAGE_GLIBC_UTILS=y
BR2_BINUTILS_VERSION_2_44_X=y
BR2_TOOLCHAIN_BUILDROOT_CXX=y
BR2_TOOLCHAIN_BUILDROOT_FORTRAN=y
BR2_PACKAGE_HOST_GDB=y
BR2_CURL="curl -q --ftp-pasv --retry 3"
BR2_WGET="wget --passive-ftp -nd -t 3"
BR2_SVN="svn"
BR2_SCP="scp"
BR2_SFTP="sftp"
BR2_DL_DIR="$(TOPDIR)/../output/download"
BR2_GNU_MIRROR="http://ftpmirror.gnu.org"
# BR2_PIC_PIE is not set
BR2_SSP_NONE=y
BR2_RELRO_NONE=y
BR2_FORTIFY_SOURCE_NONE=y
BR2_TARGET_GENERIC_HOSTNAME="uspd"
BR2_TARGET_GENERIC_ISSUE="Welcome to USDP 2.1"
BR2_INIT_SYSTEMD=y
BR2_SYSTEM_BIN_SH_BASH=y
BR2_SYSTEM_DEFAULT_PATH="/bin:/sbin:/usr/bin:/usr/sbin:/usr/local/bin:/usr/local/sbin"
BR2_ENABLE_LOCALE_WHITELIST="C.UTF-8"
BR2_GENERATE_LOCALE="ru_RU.UTF-8"
BR2_SYSTEM_ENABLE_NLS=y
BR2_ROOTFS_OVERLAY="board/diasom/overlay"
BR2_ROOTFS_POST_BUILD_SCRIPT="board/diasom/post-build-ds-rk35xx-evb.sh"
BR2_ROOTFS_POST_IMAGE_SCRIPT="support/scripts/genimage.sh"
BR2_ROOTFS_POST_SCRIPT_ARGS="-c board/diasom/genimage-ds-rk35xx-evb.cfg"
BR2_LINUX_KERNEL=y
BR2_LINUX_KERNEL_CUSTOM_GIT=y
BR2_LINUX_KERNEL_CUSTOM_REPO_URL="$(BR2_DIASOM_GIT)/linux.git"
BR2_LINUX_KERNEL_CUSTOM_REPO_VERSION="5ca75ed1d1"
BR2_LINUX_KERNEL_DEFCONFIG="diasom_rk35xx"
BR2_LINUX_KERNEL_IMAGEGZ=y
BR2_LINUX_KERNEL_INSTALL_TARGET=y
BR2_LINUX_KERNEL_NEEDS_HOST_OPENSSL=y
BR2_PACKAGE_LINUX_TOOLS_USBTOOLS=y
BR2_PACKAGE_LINUX_TOOLS_USBTOOLS_TESTUSB=y
BR2_PACKAGE_BROTLI=y
BR2_PACKAGE_GZIP=y
BR2_PACKAGE_P7ZIP=y
BR2_PACKAGE_P7ZIP_7ZA=y
BR2_PACKAGE_UNRAR=y
BR2_PACKAGE_UNZIP=y
BR2_PACKAGE_ZIP=y
BR2_PACKAGE_ZSTD=y
BR2_PACKAGE_BPFTOOL=y
BR2_PACKAGE_FIO=y
BR2_PACKAGE_GDB=y
BR2_PACKAGE_IOZONE=y
BR2_PACKAGE_LIBBPF=y
BR2_PACKAGE_LSOF=y
BR2_PACKAGE_SPIDEV_TEST=y
BR2_PACKAGE_STRESS_NG=y
BR2_PACKAGE_GREP=y
BR2_PACKAGE_JQ=y
BR2_PACKAGE_LIBTOOL=y
BR2_PACKAGE_MAKE=y
BR2_PACKAGE_SED=y
BR2_PACKAGE_BTRFS_PROGS=y
BR2_PACKAGE_DOSFSTOOLS=y
BR2_PACKAGE_DOSFSTOOLS_FATLABEL=y
BR2_PACKAGE_DOSFSTOOLS_FSCK_FAT=y
BR2_PACKAGE_DOSFSTOOLS_MKFS_FAT=y
BR2_PACKAGE_E2FSPROGS=y
BR2_PACKAGE_E2FSPROGS_DEBUGFS=y
BR2_PACKAGE_E2FSPROGS_E2IMAGE=y
BR2_PACKAGE_E2FSPROGS_E4DEFRAG=y
BR2_PACKAGE_E2FSPROGS_FUSE2FS=y
BR2_PACKAGE_E2FSPROGS_RESIZE2FS=y
BR2_PACKAGE_EXFATPROGS=y
BR2_PACKAGE_MMC_UTILS=y
BR2_PACKAGE_MTD=y
BR2_PACKAGE_NTFS_3G=y
BR2_PACKAGE_NTFS_3G_NTFSPROGS=y
BR2_PACKAGE_DT_UTILS=y
BR2_PACKAGE_EVTEST=y
BR2_PACKAGE_GPSD=y
BR2_PACKAGE_GPTFDISK=y
BR2_PACKAGE_HDPARM=y
BR2_PACKAGE_I2C_TOOLS=y
BR2_PACKAGE_LIBUBOOTENV=y
BR2_PACKAGE_LSHW=y
BR2_PACKAGE_MINICOM=y
BR2_PACKAGE_NVME=y
BR2_PACKAGE_PCIUTILS=y
BR2_PACKAGE_READ_EDID=y
BR2_PACKAGE_RS485CONF=y
BR2_PACKAGE_RTC_TOOLS=y
BR2_PACKAGE_SPI_TOOLS=y
BR2_PACKAGE_USBUTILS=y
BR2_PACKAGE_LUAJIT=y
BR2_PACKAGE_LUA_ZLIB=y
BR2_PACKAGE_PERL=y
BR2_PACKAGE_PERL_THREADS=y
BR2_PACKAGE_PYTHON3_PY_PYC=y
BR2_PACKAGE_PYTHON3_BZIP2=y
BR2_PACKAGE_PYTHON3_DECIMAL=y
BR2_PACKAGE_PYTHON3_READLINE=y
BR2_PACKAGE_PYTHON3_SQLITE=y
BR2_PACKAGE_PYTHON3_XZ=y
BR2_PACKAGE_PYTHON_ANISO8601=y
BR2_PACKAGE_PYTHON_BOLTONS=y
BR2_PACKAGE_PYTHON_CLI_HELPERS=y
BR2_PACKAGE_PYTHON_CLICK_HELP_COLORS=y
BR2_PACKAGE_PYTHON_CLICK_LOG=y
BR2_PACKAGE_PYTHON_CRCCHECK=y
BR2_PACKAGE_PYTHON_FLASK_STATISTICS=y
BR2_PACKAGE_PYTHON_FLASK_UPLOADS=y
BR2_PACKAGE_PYTHON_GPIO=y
BR2_PACKAGE_PYTHON_MCCABE=y
BR2_PACKAGE_PYTHON_PYASN1=y
BR2_PACKAGE_PYTHON_PYSERIAL=y
BR2_PACKAGE_PYTHON_SMBUS2=y
BR2_PACKAGE_PYTHON_SYNCER=y
BR2_PACKAGE_PYTHON_TZLOCAL=y
BR2_PACKAGE_PYTHON_WHEEL_FILENAME=y
BR2_PACKAGE_PYTHON_PYSTEMD=y
BR2_PACKAGE_PYTHON_GURUX_DLMS=y
BR2_PACKAGE_PYTHON_GURUX_NET=y
BR2_PACKAGE_PYTHON_GURUX_SERIAL=y
BR2_PACKAGE_PYTHON_ASN1CRYPTO=y
BR2_PACKAGE_PYTHON_ASYNC_TIMEOUT=y
BR2_PACKAGE_PYTHON_BROTLI=y
BR2_PACKAGE_PYTHON_CACHETOOLS=y
BR2_PACKAGE_PYTHON_CHARDET=y
BR2_PACKAGE_PYTHON_COLORAMA=y
BR2_PACKAGE_PYTHON_COLORLOG=y
BR2_PACKAGE_PYTHON_CRC16=y
BR2_PACKAGE_PYTHON_CRONTAB=y
BR2_PACKAGE_PYTHON_DBUS_FAST=y
BR2_PACKAGE_PYTHON_DBUS_NEXT=y
BR2_PACKAGE_PYTHON_FUTURE=y
BR2_PACKAGE_PYTHON_GREENLET=y
BR2_PACKAGE_PYTHON_GUNICORN=y
BR2_PACKAGE_PYTHON_MAKO=y
BR2_PACKAGE_PYTHON_MAKO_EXT_PYGMENTPLUGIN=y
BR2_PACKAGE_PYTHON_MAKO_EXT_BABELPLUGIN=y
BR2_PACKAGE_PYTHON_MORE_ITERTOOLS=y
BR2_PACKAGE_PYTHON_NETWORKMANAGER=y
BR2_PACKAGE_PYTHON_NUMPY=y
BR2_PACKAGE_PYTHON_PIP=y
BR2_PACKAGE_PYTHON_PLY=y
BR2_PACKAGE_PYTHON_PSYCOPG2=y
BR2_PACKAGE_PYTHON_PY=y
BR2_PACKAGE_PYTHON_PYLRU=y
BR2_PACKAGE_PYTHON_PYOPENSSL=y
BR2_PACKAGE_PYTHON_PYPARSING=y
BR2_PACKAGE_PYTHON_PYSOCKS=y
BR2_PACKAGE_PYTHON_PYTZ=y
BR2_PACKAGE_PYTHON_PYZMQ=y
BR2_PACKAGE_PYTHON_REDIS=y
BR2_PACKAGE_PYTHON_REGEX=y
BR2_PACKAGE_PYTHON_REQUESTS=y
BR2_PACKAGE_PYTHON_SDBUS_NETWORKMANAGER=y
BR2_PACKAGE_PYTHON_SIMPLEJSON=y
BR2_PACKAGE_PYTHON_SMBUS_CFFI=y
BR2_PACKAGE_PYTHON_SNAPPY=y
BR2_PACKAGE_PYTHON_TERMINALTABLES=y
BR2_PACKAGE_PYTHON_TOMLI=y
BR2_PACKAGE_PYTHON_TOMLI_W=y
BR2_PACKAGE_PYTHON_TOMLKIT=y
BR2_PACKAGE_PYTHON_VERSIONTOOLS=y
BR2_PACKAGE_PYTHON_WCWIDTH=y
BR2_PACKAGE_PYTHON_WRAPT=y
BR2_PACKAGE_PYTHON_XMLJSON=y
BR2_PACKAGE_PYTHON_XMLTODICT=y
BR2_PACKAGE_LIBVORBIS=y
BR2_PACKAGE_LIBDEFLATE=y
BR2_PACKAGE_LZ4_PROGS=y
BR2_PACKAGE_MINIZIP=y
BR2_PACKAGE_MINIZIP_ZLIB=y
BR2_PACKAGE_GNUTLS_OPENSSL=y
BR2_PACKAGE_REDIS=y
BR2_PACKAGE_SQLITE_STAT4=y
BR2_PACKAGE_SQLITE_ENABLE_COLUMN_METADATA=y
BR2_PACKAGE_SQLITE_ENABLE_FTS3=y
BR2_PACKAGE_SQLITE_ENABLE_UNLOCK_NOTIFY=y
BR2_PACKAGE_DTC=y
BR2_PACKAGE_DTC_PROGRAMS=y
BR2_PACKAGE_LIBAIO=y
BR2_PACKAGE_LIBGPIOD=y
BR2_PACKAGE_LIBGPIOD_TOOLS=y
BR2_PACKAGE_LIBGUDEV=y
BR2_PACKAGE_LIBINPUT=y
BR2_PACKAGE_LIBUSBGX=y
BR2_PACKAGE_LIBV4L=y
BR2_PACKAGE_LIBV4L_UTILS=y
BR2_PACKAGE_LIBXKBCOMMON=y
BR2_PACKAGE_LIBXKBCOMMON_TOOLS=y
BR2_PACKAGE_TSLIB=y
BR2_PACKAGE_BOOTSTRAP=y
BR2_PACKAGE_JQUERY=y
BR2_PACKAGE_JSON_C=y
BR2_PACKAGE_JSONCPP=y
BR2_PACKAGE_LIBJSON=y
BR2_PACKAGE_DPDK=y
BR2_PACKAGE_LIBCURL_CURL=y
# BR2_PACKAGE_LIBCURL_PROXY_SUPPORT is not set
# BR2_PACKAGE_LIBCURL_COOKIES_SUPPORT is not set
BR2_PACKAGE_LIBCURL_WEBSOCKETS_SUPPORT=y
BR2_PACKAGE_LIBNICE=y
BR2_PACKAGE_LIBSRTP=y
BR2_PACKAGE_LIBTEAM=y
BR2_PACKAGE_ELFUTILS_PROGS=y
BR2_PACKAGE_LIBBSD=y
BR2_PACKAGE_LIBPTHREAD_STUBS=y
BR2_PACKAGE_ICU=y
BR2_PACKAGE_LIBFRIBIDI=y
BR2_PACKAGE_PCRE2_16=y
BR2_PACKAGE_RE2=y
BR2_PACKAGE_UTFCPP=y
BR2_PACKAGE_MOBILE_BROADBAND_PROVIDER_INFO=y
BR2_PACKAGE_XUTIL_UTIL_MACROS=y
BR2_PACKAGE_ARP_SCAN=y
BR2_PACKAGE_BLUEZ_TOOLS=y
BR2_PACKAGE_BLUEZ5_UTILS=y
BR2_PACKAGE_BLUEZ5_UTILS_OBEX=y
BR2_PACKAGE_BLUEZ5_UTILS_CLIENT=y
BR2_PACKAGE_BLUEZ5_UTILS_MONITOR=y
BR2_PACKAGE_BLUEZ5_UTILS_TOOLS=y
BR2_PACKAGE_BLUEZ5_UTILS_PLUGINS_AUDIO=y
BR2_PACKAGE_BLUEZ5_UTILS_PLUGINS_HID=y
BR2_PACKAGE_CAN_UTILS=y
BR2_PACKAGE_DHCP=y
BR2_PACKAGE_DHCP_CLIENT=y
BR2_PACKAGE_DNSMASQ=y
BR2_PACKAGE_ETHTOOL=y
BR2_PACKAGE_FAIL2BAN=y
BR2_PACKAGE_FIREWALLD=y
BR2_PACKAGE_HOSTAPD=y
BR2_PACKAGE_HOSTAPD_WPA3=y
BR2_PACKAGE_IPERF=y
BR2_PACKAGE_IPERF3=y
BR2_PACKAGE_IPROUTE2=y
BR2_PACKAGE_IPTABLES=y
BR2_PACKAGE_IPTABLES_NFTABLES=y
BR2_PACKAGE_IW=y
BR2_PACKAGE_LINUXPTP=y
BR2_PACKAGE_NET_TOOLS=y
BR2_PACKAGE_NETCAT=y
BR2_PACKAGE_NETSTAT_NAT=y
BR2_PACKAGE_NETWORK_MANAGER=y
BR2_PACKAGE_NETWORK_MANAGER_TUI=y
BR2_PACKAGE_NETWORK_MANAGER_CLI=y
BR2_PACKAGE_NETWORK_MANAGER_OPENVPN=y
BR2_PACKAGE_NGINX=y
BR2_PACKAGE_NGINX_HTTP_SSL_MODULE=y
BR2_PACKAGE_NTP=y
BR2_PACKAGE_NTP_SNTP=y
BR2_PACKAGE_NTP_NTP_KEYGEN=y
BR2_PACKAGE_NTP_NTP_SHM_CLK=y
BR2_PACKAGE_NTP_NTP_WAIT=y
BR2_PACKAGE_NTP_NTPD_ATOM_PPS=y
BR2_PACKAGE_NTP_NTPDATE=y
BR2_PACKAGE_NTP_NTPDC=y
BR2_PACKAGE_NTP_NTPQ=y
BR2_PACKAGE_NTP_NTPSNMPD=y
BR2_PACKAGE_NTP_NTPTIME=y
BR2_PACKAGE_NTP_NTPTRACE=y
BR2_PACKAGE_NTP_TICKADJ=y
BR2_PACKAGE_NTPSEC=y
BR2_PACKAGE_NTPSEC_CLASSIC_MODE=y
BR2_PACKAGE_OPENSSH=y
# BR2_PACKAGE_OPENSSH_SANDBOX is not set
BR2_PACKAGE_OPENVPN=y
BR2_PACKAGE_RSYNC=y
BR2_PACKAGE_SER2NET=y
BR2_PACKAGE_SOCAT=y
BR2_PACKAGE_TCPDUMP=y
BR2_PACKAGE_TFTPD=y
BR2_PACKAGE_WGET=y
BR2_PACKAGE_WIRELESS_REGDB=y
BR2_PACKAGE_WIRELESS_TOOLS=y
BR2_PACKAGE_OPKG=y
BR2_PACKAGE_OPKG_GPG_SIGN=y
BR2_PACKAGE_BASH_COMPLETION=y
BR2_PACKAGE_LOGROTATE=y
BR2_PACKAGE_SCREEN=y
BR2_PACKAGE_SUDO=y
BR2_PACKAGE_WHICH=y
BR2_PACKAGE_XXHASH=y
BR2_PACKAGE_HTOP=y
BR2_PACKAGE_IOTOP=y
BR2_PACKAGE_NUMACTL=y
BR2_PACKAGE_RAUC_DBUS=y
BR2_PACKAGE_RAUC_GPT=y
BR2_PACKAGE_RAUC_JSON=y
BR2_PACKAGE_RAUC_HAWKBIT_UPDATER=y
BR2_PACKAGE_RSYSLOG=y
BR2_PACKAGE_SEATD=y
BR2_PACKAGE_SEATD_DAEMON=y
BR2_PACKAGE_SYSTEMD_FIRSTBOOT=y
BR2_PACKAGE_SYSTEMD_LOCALED=y
BR2_PACKAGE_SYSTEMD_LOGIND=y
BR2_PACKAGE_SYSTEMD_RANDOMSEED=y
BR2_PACKAGE_SYSTEMD_RFKILL=y
BR2_PACKAGE_TAR=y
BR2_PACKAGE_UTIL_LINUX_BINARIES=y
BR2_PACKAGE_UTIL_LINUX_RFKILL=y
BR2_PACKAGE_WATCHDOG=y
BR2_PACKAGE_XDG_DBUS_PROXY=y
BR2_PACKAGE_ED=y
BR2_PACKAGE_LESS=y
BR2_PACKAGE_MC=y
BR2_PACKAGE_NANO=y
BR2_PACKAGE_ROCKCHIP=y
BR2_TARGET_ROOTFS_EXT2=y
BR2_TARGET_ROOTFS_EXT2_4=y
BR2_TARGET_ROOTFS_EXT2_SIZE="2G"
# BR2_TARGET_ROOTFS_TAR is not set
BR2_TARGET_BAREBOX=y
BR2_TARGET_BAREBOX_CUSTOM_GIT=y
BR2_TARGET_BAREBOX_NEEDS_OPENSSL=y
BR2_TARGET_BAREBOX_NEEDS_LIBUSB=y
BR2_TARGET_BAREBOX_CUSTOM_GIT_REPO_URL="https://github.com/germka/barebox"
BR2_TARGET_BAREBOX_CUSTOM_GIT_VERSION="c6ac8d71faa7a48e687a7bf26b6d09f0a12c49a1"
BR2_TARGET_BAREBOX_BOARD_DEFCONFIG="ds_uspd"
BR2_TARGET_BAREBOX_IMAGE_FILE="scripts/rk-usb-loader images/barebox-diasom-rk35*-evb.img arch/arm/boards/diasom-rk35*/*.dtbo"
BR2_TARGET_BAREBOX_BAREBOXENV=y
BR2_PACKAGE_HOST_ANDROID_TOOLS=y
BR2_PACKAGE_HOST_ANDROID_TOOLS_FASTBOOT=y
BR2_PACKAGE_HOST_BTRFS_PROGS=y
BR2_PACKAGE_HOST_CMAKE=y
BR2_PACKAGE_HOST_DFU_UTIL=y
BR2_PACKAGE_HOST_DTC=y
BR2_PACKAGE_HOST_FIRMWARE_UTILS=y
BR2_PACKAGE_HOST_GENIMAGE=y
BR2_PACKAGE_HOST_GPTFDISK=y
BR2_PACKAGE_HOST_JQ=y
BR2_PACKAGE_HOST_PYTHON_LXML=y
BR2_PACKAGE_HOST_PYTHON_SIX=y
BR2_PACKAGE_HOST_PYTHON3_SSL=y
BR2_PACKAGE_HOST_RAUC=y
BR2_PACKAGE_HOST_RUSTC=y
BR2_PACKAGE_HOST_ZIP=y
```

## package/python-astroid/Config.in
```kconfig
config BR2_PACKAGE_PYTHON_ASTROID
	bool "python-astroid"
	select BR2_PACKAGE_PYTHON_TYPING_EXTENSIONS # runtime
	help
```

## package/python-backports-strenum/Config.in
```kconfig
config BR2_PACKAGE_PYTHON_BACKPORTS_STRENUM
	bool "python-backports-strenum"
	help
	  Base class for creating enumerated constants that are also
	  subclasses of str.

	  https://github.com/clbarnes/backports.strenum
```

## package/python-boltons/Config.in
```kconfig
config BR2_PACKAGE_PYTHON_BOLTONS
	bool "python-boltons"
	help
	  When they're not builtins, they're boltons.

	  https://github.com/mahmoud/boltons
```

## package/python-build/Config.in
```kconfig
config BR2_PACKAGE_PYTHON_BUILD
	bool "python-build"
	select BR2_PACKAGE_PYTHON_COLORAMA # runtime
	select BR2_PACKAGE_PYTHON_IMPORTLIB_METADATA # runtime
	select BR2_PACKAGE_PYTHON_PACKAGING # runtime
	select BR2_PACKAGE_PYTHON_PYPROJECT_HOOKS # runtime
	select BR2_PACKAGE_PYTHON_TOMLI # runtime
	help
```

## package/python-cleo/Config.in
```kconfig
config BR2_PACKAGE_PYTHON_CLEO
	bool "python-cleo"
	select BR2_PACKAGE_PYTHON_CRASHTEST # runtime
	select BR2_PACKAGE_PYTHON_RAPIDFUZZ # runtime
	help
	  Cleo allows you to create beautiful and testable command-
	  line interfaces.

	  https://github.com/python-poetry/cleo
```

## package/python-cli-helpers/Config.in
```kconfig
config BR2_PACKAGE_PYTHON_CLI_HELPERS
	bool "python-cli-helpers"
	select BR2_PACKAGE_PYTHON_CONFIGOBJ # runtime
	select BR2_PACKAGE_PYTHON_TABULATE # runtime
	help
	  Helpers for building command-line apps.

	  https://github.com/dbcli/cli_helpers
```

## package/python-click-extra/Config.in
```kconfig
config BR2_PACKAGE_PYTHON_CLICK_EXTRA
	bool "python-click-extra"
	select BR2_PACKAGE_PYTHON_BOLTONS # runtime
	select BR2_PACKAGE_PYTHON_CLICK # runtime
	select BR2_PACKAGE_PYTHON_CLOUP # runtime
	select BR2_PACKAGE_PYTHON_DEEPMERGE # runtime
	select BR2_PACKAGE_PYTHON_EXTRA_PLATFORMS # runtime
	select BR2_PACKAGE_PYTHON_REQUESTS # runtime
	select BR2_PACKAGE_PYTHON_TABULATE # runtime
	select BR2_PACKAGE_PYTHON_TOMLI # runtime
	select BR2_PACKAGE_PYTHON_WCMATCH # runtime
	help
	  🌈 Drop-in replacement for Click to make user-friendly and
	  colorful CLI.

	  https://github.com/kdeldycke/click-extra
```

## package/python-click-help-colors/Config.in
```kconfig
config BR2_PACKAGE_PYTHON_CLICK_HELP_COLORS
	bool "python-click-help-colors"
	select BR2_PACKAGE_PYTHON_CLICK # runtime
	help
	  Colorization of help messages in Click.

	  https://github.com/click-contrib/click-help-colors
```

## package/python-click-log/Config.in
```kconfig
config BR2_PACKAGE_PYTHON_CLICK_LOG
	bool "python-click-log"
	select BR2_PACKAGE_PYTHON_CLICK # runtime
	help
	  Logging integration for Click.

	  https://github.com/click-contrib/click-log
```

## package/python-coloredlogs/Config.in
```kconfig
config BR2_PACKAGE_PYTHON_COLOREDLOGS
	bool "python-coloredlogs"
	select BR2_PACKAGE_PYTHON_HUMANFRIENDLY # runtime
	help
	  Colored terminal output for Python's logging module.

	  https://coloredlogs.readthedocs.io
```

## package/python-crccheck/Config.in
```kconfig
config BR2_PACKAGE_PYTHON_CRCCHECK
	bool "python-crccheck"
	help
	  Calculation library for CRCs and checksums.

	  https://github.com/MartinScharrer/crccheck
```

## package/python-cyclonedx-python-lib/Config.in
```kconfig
config BR2_PACKAGE_PYTHON_CYCLONEDX_PYTHON_LIB
	bool "python-cyclonedx-python-lib"
	select BR2_PACKAGE_PYTHON_LICENSE_EXPRESSION # runtime
	select BR2_PACKAGE_PYTHON_PACKAGEURL_PYTHON # runtime
	select BR2_PACKAGE_PYTHON_PY_SERIALIZABLE # runtime
	select BR2_PACKAGE_PYTHON_SORTEDCONTAINERS # runtime
	select BR2_PACKAGE_PYTHON_TYPING_EXTENSIONS # runtime
	help
	  Python library for CycloneDX.

	  https://github.com/CycloneDX/cyclonedx-python-lib/#readme
```

## package/python-dill/Config.in
```kconfig
config BR2_PACKAGE_PYTHON_DILL
	bool "python-dill"
	help
	  serialize all of Python.

	  https://github.com/uqfoundation/dill
```

## package/python-dulwich/Config.in
```kconfig
config BR2_PACKAGE_PYTHON_DULWICH
	bool "python-dulwich"
	select BR2_PACKAGE_PYTHON_TYPING_EXTENSIONS # runtime
	select BR2_PACKAGE_PYTHON_URLLIB3 # runtime
	help
	  Python Git Library.

	  https://www.dulwich.io/
```

## package/python-extra-platforms/Config.in
```kconfig
config BR2_PACKAGE_PYTHON_EXTRA_PLATFORMS
	bool "python-extra-platforms"
	select BR2_PACKAGE_PYTHON_DISTRO # runtime
	help
	  Detect platforms and group them by family.

	  https://github.com/kdeldycke/extra-platforms
```

## package/python-fastjsonschema/Config.in
```kconfig
config BR2_PACKAGE_PYTHON_FASTJSONSCHEMA
	bool "python-fastjsonschema"
	help
	  Fastest Python implementation of JSON schema.

	  https://github.com/horejsek/python-fastjsonschema
```

## package/python-flask-statistics/Config.in
```kconfig
config BR2_PACKAGE_PYTHON_FLASK_STATISTICS
	bool "python-flask-statistics"
	select BR2_PACKAGE_PYTHON_FLASK # runtime
	select BR2_PACKAGE_PYTHON_FLASK_SQLALCHEMY # runtime
	help
	  Package to collect statistics in Flask.

	  https://github.com/HealYouDown/flask-statistics
```

## package/python-flask-uploads/Config.in
```kconfig
config BR2_PACKAGE_PYTHON_FLASK_UPLOADS
	bool "python-flask-uploads"
	select BR2_PACKAGE_PYTHON_FLASK # runtime
	help
	  Flexible and efficient upload handling for Flask.

	  https://github.com/maxcountryman/flask-uploads
```

## package/python-flexcache/Config.in
```kconfig
config BR2_PACKAGE_PYTHON_FLEXCACHE
	bool "python-flexcache"
	select BR2_PACKAGE_PYTHON_TYPING_EXTENSIONS # runtime
	help
	  Saves and loads to the cache a transformed versions of a
	  source object.

	  https://github.com/hgrecco/flexcache
```

## package/python-flexparser/Config.in
```kconfig
config BR2_PACKAGE_PYTHON_FLEXPARSER
	bool "python-flexparser"
	select BR2_PACKAGE_PYTHON_TYPING_EXTENSIONS # runtime
	help
	  Parsing made fun ... using typing.

	  https://github.com/hgrecco/flexparser
```

## package/python-gurux-common/Config.in
```kconfig
config BR2_PACKAGE_PYTHON_GURUX_COMMON
	bool "python-gurux-common"
	help
	  Gurux common helpers for device commmunication.

	  https://github.com/gurux/gurux.common.python
```
