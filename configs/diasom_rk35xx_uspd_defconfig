## package/python-gurux-dlms/Config.in
```kconfig
config BR2_PACKAGE_PYTHON_GURUX_DLMS
	bool "python-gurux-dlms"
	help
	  Gurux DLMS library for Python.

	  https://github.com/gurux/gurux.dlms.python
```

## package/python-gurux-net/Config.in
```kconfig
config BR2_PACKAGE_PYTHON_GURUX_NET
	bool "python-gurux-net"
	select BR2_PACKAGE_PYTHON_GURUX_COMMON # runtime
	help
	  Gurux network media is used to commmunication with TCP/IP
	  or UDP connections.

	  https://github.com/gurux/gurux.net.python
```
