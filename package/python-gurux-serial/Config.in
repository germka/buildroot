## package/python-gurux-serial/Config.in
```kconfig
config BR2_PACKAGE_PYTHON_GURUX_SERIAL
	bool "python-gurux-serial"
	select BR2_PACKAGE_PYTHON_GURUX_COMMON # runtime
	help
	  Gurux serial media is used to commmunication with serial
	  port connections.

	  https://github.com/gurux/gurux.serial.python
```

## package/python-humanfriendly/Config.in
```kconfig
config BR2_PACKAGE_PYTHON_HUMANFRIENDLY
	bool "python-humanfriendly"
	select BR2_PACKAGE_PYTHON_MONOTONIC # runtime
	select BR2_PACKAGE_PYTHON_PYREADLINE # runtime
	select BR2_PACKAGE_PYTHON_PYREADLINE3 # runtime
	help
	  Human friendly output for text interfaces using Python.

	  https://humanfriendly.readthedocs.io
```

## package/python-isort/Config.in
```kconfig
config BR2_PACKAGE_PYTHON_ISORT
	bool "python-isort"
	help
	  A Python utility / library to sort Python imports.

	  https://pycqa.github.io/isort/index.html
```

## package/python-lazy-object-proxy/Config.in
```kconfig
config BR2_PACKAGE_PYTHON_LAZY_OBJECT_PROXY
	bool "python-lazy-object-proxy"
	help
```

## package/python-license-expression/Config.in
```kconfig
config BR2_PACKAGE_PYTHON_LICENSE_EXPRESSION
	bool "python-license-expression"
	select BR2_PACKAGE_PYTHON_BOOLEANPY # runtime
	help
	  license-expression is a comprehensive utility library to
	  parse, compare, simplify and normalize license expressions
	  (such as SPDX license expressions) using boolean logic.

	  https://github.com/aboutcode-org/license-expression
```

## package/python-meta-package-manager/Config.in
```kconfig
config BR2_PACKAGE_PYTHON_META_PACKAGE_MANAGER
	bool "python-meta-package-manager"
	select BR2_PACKAGE_PYTHON_BACKPORTS_STRENUM # runtime
	select BR2_PACKAGE_PYTHON_BOLTONS # runtime
	select BR2_PACKAGE_PYTHON_CLICK_EXTRA # runtime
	select BR2_PACKAGE_PYTHON_CYCLONEDX_PYTHON_LIB # runtime
	select BR2_PACKAGE_PYTHON_EXTRA_PLATFORMS # runtime
	select BR2_PACKAGE_PYTHON_MORE_ITERTOOLS # runtime
	select BR2_PACKAGE_PYTHON_PACKAGEURL_PYTHON # runtime
	select BR2_PACKAGE_PYTHON_SPDX_TOOLS # runtime
	select BR2_PACKAGE_PYTHON_TABULATE # runtime
	select BR2_PACKAGE_PYTHON_TOMLI # runtime
	select BR2_PACKAGE_PYTHON_TOMLI_W # runtime
	select BR2_PACKAGE_PYTHON_XMLTODICT # runtime
	help
	  🎁 wraps all package managers with a unifying CLI.

	  https://github.com/kdeldycke/meta-package-manager
```

## package/python-ndg-httpsclient/Config.in
```kconfig
config BR2_PACKAGE_PYTHON_NDG_HTTPSCLIENT
	bool "python-ndg-httpsclient"
	select BR2_PACKAGE_PYTHON_PYASN1 # runtime
	select BR2_PACKAGE_PYTHON_PYOPENSSL # runtime
	help
	  Provides enhanced HTTPS support for httplib and urllib2
	  using PyOpenSSL.

	  https://github.com/cedadev/ndg_httpsclient/
```

## package/python-overrides/Config.in
```kconfig
config BR2_PACKAGE_PYTHON_OVERRIDES
	bool "python-overrides"
	select BR2_PACKAGE_PYTHON_TYPING # runtime
	help
	  A decorator to automatically detect mismatch when
	  overriding a method.

	  https://github.com/mkorpela/overrides
```

## package/python-packageurl-python/Config.in
```kconfig
config BR2_PACKAGE_PYTHON_PACKAGEURL_PYTHON
	bool "python-packageurl-python"
	help
	  A purl aka. Package URL parser and builder.

	  https://github.com/package-url/packageurl-python
```

## package/python-pint/Config.in
```kconfig
config BR2_PACKAGE_PYTHON_PINT
	bool "python-pint"
	select BR2_PACKAGE_PYTHON_FLEXCACHE # runtime
	select BR2_PACKAGE_PYTHON_FLEXPARSER # runtime
	select BR2_PACKAGE_PYTHON_PLATFORMDIRS # runtime
	select BR2_PACKAGE_PYTHON_TYPING_EXTENSIONS # runtime
	help
	  Physical quantities module.

	  https://github.com/hgrecco/pint
```

## package/python-pkginfo/Config.in
```kconfig
config BR2_PACKAGE_PYTHON_PKGINFO
	bool "python-pkginfo"
	help
	  Query metadata from sdists / bdists / installed packages.

	  https://code.launchpad.net/~tseaver/pkginfo/trunk
```

## package/python-poetry/Config.in
```kconfig
config BR2_PACKAGE_PYTHON_POETRY
	bool "python-poetry"
	select BR2_PACKAGE_PYTHON_BUILD # runtime
	select BR2_PACKAGE_PYTHON_CACHECONTROL # runtime
	select BR2_PACKAGE_PYTHON_CLEO # runtime
	select BR2_PACKAGE_PYTHON_DULWICH # runtime
	select BR2_PACKAGE_PYTHON_FASTJSONSCHEMA # runtime
	select BR2_PACKAGE_PYTHON_FINDPYTHON # runtime
	select BR2_PACKAGE_PYTHON_IMPORTLIB_METADATA # runtime
	select BR2_PACKAGE_PYTHON_INSTALLER # runtime
	select BR2_PACKAGE_PYTHON_KEYRING # runtime
	select BR2_PACKAGE_PYTHON_PACKAGING # runtime
	select BR2_PACKAGE_PYTHON_PBS_INSTALLER # runtime
	select BR2_PACKAGE_PYTHON_PKGINFO # runtime
	select BR2_PACKAGE_PYTHON_PLATFORMDIRS # runtime
	select BR2_PACKAGE_PYTHON_POETRY_CORE # runtime
	select BR2_PACKAGE_PYTHON_PYPROJECT_HOOKS # runtime
	select BR2_PACKAGE_PYTHON_REQUESTS # runtime
	select BR2_PACKAGE_PYTHON_REQUESTS_TOOLBELT # runtime
	select BR2_PACKAGE_PYTHON_SHELLINGHAM # runtime
	select BR2_PACKAGE_PYTHON_TOMLI # runtime
	select BR2_PACKAGE_PYTHON_TOMLKIT # runtime
	select BR2_PACKAGE_PYTHON_TROVE_CLASSIFIERS # runtime
	select BR2_PACKAGE_PYTHON_VIRTUALENV # runtime
	select BR2_PACKAGE_PYTHON_XATTR # runtime
	help
	  Python dependency management and packaging made easy.

	  https://python-poetry.org/
```

## package/python-py-linq/Config.in
```kconfig
config BR2_PACKAGE_PYTHON_PY_LINQ
	bool "python-py-linq"
	select BR2_PACKAGE_PYTHON_FUTURE # runtime
	select BR2_PACKAGE_PYTHON_SIX # runtime
	help
	  LINQ (Language Integrated Query) is a popular querying
	  language available in .NET. This library ports the language
	  so that developers can query collections of objects using
	  the same syntax. This library would be useful for Python
	  developers with experience using the expressiveness and
	  power of LINQ.

	  https://github.com/viralogic/py-enumerable
```

## package/python-pylint/Config.in
```kconfig
config BR2_PACKAGE_PYTHON_PYLINT
	bool "python-pylint"
	select BR2_PACKAGE_PYTHON_ASTROID # runtime
	select BR2_PACKAGE_PYTHON_COLORAMA # runtime
	select BR2_PACKAGE_PYTHON_DILL # runtime
	select BR2_PACKAGE_PYTHON_ISORT # runtime
	select BR2_PACKAGE_PYTHON_MCCABE # runtime
	select BR2_PACKAGE_PYTHON_PLATFORMDIRS # runtime
	select BR2_PACKAGE_PYTHON_TOMLI # runtime
	select BR2_PACKAGE_PYTHON_TOMLKIT # runtime
	select BR2_PACKAGE_PYTHON_TYPING_EXTENSIONS # runtime
	help
```

## package/python-pyreadline3/Config.in
```kconfig
config BR2_PACKAGE_PYTHON_PYREADLINE3
	bool "python-pyreadline3"
	help
	  A python implementation of GNU readline.

	  https://github.com/pyreadline3/pyreadline3
```

## package/python-pystemd/Config.in
```kconfig
config BR2_PACKAGE_PYTHON_PYSTEMD
	bool "python-pystemd"
	select BR2_PACKAGE_PYTHON_LXML # runtime
	select BR2_PACKAGE_PYTHON_PSUTIL # runtime
	help
```

## package/python-spdx-tools/Config.in
```kconfig
config BR2_PACKAGE_PYTHON_SPDX_TOOLS
	bool "python-spdx-tools"
	select BR2_PACKAGE_PYTHON_BEARTYPE # runtime
	select BR2_PACKAGE_PYTHON_CLICK # runtime
	select BR2_PACKAGE_PYTHON_LICENSE_EXPRESSION # runtime
	select BR2_PACKAGE_PYTHON_PLY # runtime
	select BR2_PACKAGE_PYTHON_PYYAML # runtime
	select BR2_PACKAGE_PYTHON_RDFLIB # runtime
	select BR2_PACKAGE_PYTHON_SEMANTIC_VERSION # runtime
	select BR2_PACKAGE_PYTHON_URITOOLS # runtime
	select BR2_PACKAGE_PYTHON_XMLTODICT # runtime
	help
	  SPDX parser and tools.

	  https://github.com/spdx/tools-python
```

## package/python-syncer/Config.in
```kconfig
config BR2_PACKAGE_PYTHON_SYNCER
	bool "python-syncer"
	help
	  Async to sync converter.

	  https://github.com/miyakogi/syncer
```

## package/python-tzlocal/Config.in
```kconfig
config BR2_PACKAGE_PYTHON_TZLOCAL
	bool "python-tzlocal"
	select BR2_PACKAGE_PYTHON_TZDATA # runtime
	help
```

## package/python-uritools/Config.in
```kconfig
config BR2_PACKAGE_PYTHON_URITOOLS
	bool "python-uritools"
	help
	  URI parsing, classification and composition.

	  https://github.com/tkem/uritools/
```

## package/python-virtualenv/Config.in
```kconfig
config BR2_PACKAGE_PYTHON_VIRTUALENV
	bool "python-virtualenv"
	select BR2_PACKAGE_PYTHON_DISTLIB # runtime
	select BR2_PACKAGE_PYTHON_FILELOCK # runtime
	select BR2_PACKAGE_PYTHON_IMPORTLIB_METADATA # runtime
	select BR2_PACKAGE_PYTHON_PLATFORMDIRS # runtime
	select BR2_PACKAGE_PYTHON_TYPING_EXTENSIONS # runtime
	help
	  Virtual Python Environment builder.

	  https://github.com/pypa/virtualenv
```

## package/python-xattr/Config.in
```kconfig
config BR2_PACKAGE_PYTHON_XATTR
	bool "python-xattr"
	select BR2_PACKAGE_PYTHON_CFFI # runtime
	help
	  Python wrapper for extended filesystem attributes.

	  https://github.com/xattr/xattr
```
